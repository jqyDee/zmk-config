## config/west.yml
```yaml
manifest:
  defaults:
    remote: urob

  remotes:
    - name: upstream
      url-base: https://github.com/zmkfirmware
    - name: urob
      url-base: https://github.com/urob

  projects:
    - name: zmk-helpers
      revision: main
      path: modules/helpers
    - name: zmk-auto-layer
      revision: main
      path: modules/auto-layer
    - name: zmk-tri-state
      revision: main
      path: modules/tri-state

    # ZMK with mouse support (urob fork, mouse-3.2 branch)
    - name: zmk
      remote: urob
      revision: mouse-3.2
      path: .
      import:
        file: app/west.yml
        path-prefix: zmk

  self:
    path: config
```
