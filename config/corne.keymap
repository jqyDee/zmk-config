/* source key position labels */
#include "zmk-helpers/key-labels/42.h"

/* map the Glove's extra keys */
#define X_LT    &kp TAB
#define X_RT    &kp LBKT

#define X_LM    &kp ESC
#define X_RM    &kp SQT

#define X_LB    &kp LSHFT
#define X_RB    &kp CAPS

#define X_LH    &mo SYM
#define X_RH    &mo SYM

/* activate bluetooth */
#define CONFIG_WIRELESS

/* source the main keymap */
#include "base.keymap"

